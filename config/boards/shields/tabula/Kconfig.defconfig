## config/boards/shields/tabula/Kconfig.defconfig
```kconfig
if SHIELD_TABULA_LEFT

config ZMK_KEYBOARD_NAME
    default "Tabula"

config ZMK_SPLIT_ROLE_CENTRAL
    default y

endif

if SHIELD_TABULA_LEFT || SHIELD_TABULA_RIGHT

config ZMK_SPLIT
    default y

endif
```

## config/boards/shields/tabula/Kconfig.shield
```kconfig
config SHIELD_TABULA_LEFT
    def_bool $(shields_list_contains,tabula_left)

config SHIELD_TABULA_RIGHT
    def_bool $(shields_list_contains,tabula_right)
```
